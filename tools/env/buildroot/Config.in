## tools/env/buildroot/Config.in
```kconfig
source "$BR2_EXTERNAL_RPV_PATH/package/avr8-gnu-toolchain/Config.in"
source "$BR2_EXTERNAL_RPV_PATH/package/x86-64-elf-gdb/Config.in"
```

## tools/env/buildroot/package/avr8-gnu-toolchain/Config.in
```kconfig
config BR2_PACKAGE_HOST_AVR8_GNU_TOOLCHAIN
	bool "host avr8-gnu-toolchain"
	depends on BR2_HOSTARCH = "x86_64"
	help
	  Prebuilt Microchip AVR 8-bit GNU toolchain: binutils, avr-gcc,
	  AVR-LibC and avr-gdb. It is only available for x86_64 hosts.

	  https://www.microchip.com/en-us/tools-resources/develop/microchip-studio/gcc-compilers
```

## tools/env/buildroot/package/x86-64-elf-gdb/Config.in
```kconfig
config BR2_PACKAGE_HOST_X86_64_ELF_GDB
	bool "host x86_64-elf-gdb"
	help
	  GDB for the bare-metal x86_64-elf target, used to debug the
	  kernel through the QEMU gdb stub. Built with TUI support,
	  without Python.

	  https://www.sourceware.org/gdb/
```
